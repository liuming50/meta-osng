## conf/layer.conf
```bitbake
BBPATH .= ":${LAYERDIR}"

BBFILES += "${LAYERDIR}/recipes-*/*/*.bb \
	${LAYERDIR}/recipes-*/*/*.bbappend"

BBFILE_COLLECTIONS += "osng"
BBFILE_PATTERN_osng = "^${LAYERDIR}/"
BBFILE_PRIORITY_osng = "10"
```
